/*
 * AgitPOV
 * 12-LED POV for Arduino
 * Can display both latin and arabic letters.
 *
 * (c) 2011-2012
 
 Alan Kwok
 
 *       Alexandre Castonguay
 *       Sofian Audry
 *       Jean-Pascal Bellemare
 * (c) 2013, Changes: 7 leds to 12 and 5 to 7
 *		 Daniel Felipe Valencia
 *		 dfvalen0223@gmail.com
 * (c) 2013, Changes: added new pinout for 12 leds
 *               Andre Girard
 *               andre@andre-girard.com 
 *
 * This program is free software: you can redistribute it and/or modify
 * it under the terms of the GNU General Public License as published by
 * the Free Software Foundation, either version 3 of the License, or
 * (at your option) any later version.
 *
 * This program is distributed in the hope that it will be useful,
 * but WITHOUT ANY WARRANTY; without even the implied warranty of
 * MERCHANTABILITY or FITNESS FOR A PARTICULAR PURPOSE.  See the
 * GNU General Public License for more details.
 *
 * You should have received a copy of the GNU General Public License
 * along with this program.  If not, see <http://www.gnu.org/licenses/>.
 */

#include <avr/pgmspace.h>
#include <string.h>
#include <string>
#include <cwchar>


#ifndef POV_USE_ARABIC
#define POV_USE_LATIN
#endif


unsigned char povPins[]={18,19,4,5,6,7,8,9,10,11,12,13};




// Letter width. since i have 12 LED, then each letter would look like a 12 x 7 matrix
#define POV_WIDTH 7
#define POV_MAX_MESSAGE_LENGTH 26
//#define POV_US_BETWEEN_LETTERS 4500
//#define POV_US_BETWEEN_COLUMNS 3300




wchar_t povMessage[POV_MAX_MESSAGE_LENGTH];
unsigned char povMessageLength;

unsigned long povIntervalColumns = 3300;
unsigned long povIntervalLetters = 4500;
unsigned long povTimeStamp;



void povSetup() {
  
  // Set up pin 0 - 12 as OUTPUT.
  for (unsigned char k=0;k<12;k++) pinMode(povPins[k],OUTPUT);
  
  pinMode(A2,OUTPUT); // Pin as output
  digitalWrite(A2,HIGH); // Send 3V to hall sensor
  pinMode(A3,INPUT); // Pin as input
  digitalWrite(A3,HIGH); // Activate pull-up
 
  
}


// LATIN PRIVATE
#ifdef POV_USE_LATIN
prog_uint16_t PROGMEM POV_FONT [][7] =
//uint8_t LATIN_CHARS [][5] =
{   
   {0x000, 0x000, 0x000, 0x000, 0x000, 0x000, 0x000}, //space U+0020
   {0x000, 0x000, 0x33f, 0x37f, 0x000, 0x000, 0x000}, //!
   {0x000, 0x000, 0x003, 0x000, 0x003, 0x000, 0x000}, //"
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   {0x16a, 0x26a, 0x20a, 0x27a, 0x20a, 0x26a, 0x16a}  //〠 U+3020 Japanese postal mark
};

void povSetMessage( const wchar_t* str, int pml) {
  
  povMessageLength = pml; //std::wcslen (str);  //strlen(str);
  povMessageLength = min(povMessageLength, POV_MAX_MESSAGE_LENGTH);
  
  for (int i=0; i<povMessageLength; i++) {
    wchar_t c = str[i];
    wchar_t a;
    if (0x0020 <= c && c <= 0x007E)
      a = c - 0x0020;
    else if (0x00A1 <= c && c <= 0x00A9)
      a = c - 66; // (0xA1 - 95)
    else if (0x00AB == c)
      a = c - 67; // (0xAB - 104)
    else if (0x00B4 == c)
      a = c - 75; // (0xB4 - 105)
    else if (0x00BB == c)
      a = c - 81; // (0xBB - 106)
    else if (0x00BF <= c && c <= 0x00DD)
      a = c - 84; // (0xBF - 107)
    else if (0x00E0 <= c && c <= 0x00EF)
      a = c - 86; // (0xE0 - 138)
    else if (0x00F1 <= c && c <= 0x00FD)
      a = c - 87; // (0xF1 - 154)
    else if (0x00FF == c)
      a = c - 88; // (0xFF - 167)
    else {
      switch (c) {
      case L'€': 
        a = 168; 
        break;
      case L'⍨': 
        a = 169; 
        break;
      case L'☃': 
        a = 170; 
        break;
      case L'☠': 
        a = 171; 
        break;
      case L'☹': 
        a = 172; 
        break;
      case L'☺': 
        a = 173; 
        break;
      case L'☻': 
        a = 174; 
        break;
      case L'♡': 
        a = 175; 
        break;
      case L'♥': 
        a = 176; 
        break;
      case L'〠': 
        a = 177; 
        break;	
      default : 
        a = 0; 
        break;
      }
    }
    povMessage[i] = a;
    //Serial.print("c: ");
    //Serial.println(c);    
    //Serial.print("a: ");
    //Serial.println(a);
  }
}



#endif

// povDisplayRaw(LATIN_CHARS, alphaMsg, strlen(msg), 4500, 3300);

//method of displaying the letters. displaying each column (one hex number) of the letter one by one through PORTD. then after a letter, it puts a space in between and move onto the next letter. until however long of the String you wish to display.
//each letter is first turned into ASCII integer, then minus 65. It would then be the row of the letter from the library above. (ex. A is 65 in ASCII, but row 0 in my library)
// furthermore, because of the way i made the hardware, it displays each letter starting from the back of the sentence, and each letter from the right most column.
void povDisplay() { 
  
  
  for (int i = povMessageLength-1; i>=0; i--)
  {
    for (int j = (POV_WIDTH-1); j>=0; j--)
    {
      unsigned int b = pgm_read_word_near(&POV_FONT[povMessage[i]][j]);//message[(int)POVstring[i]-0][j];
//      byte b = fontSet[message[i]][j];
      for (int k=0; k<12; k++) digitalWrite(povPins[k], bitRead(~b,k));
        delayMicroseconds(povIntervalColumns); //delayMicroseconds(POV_US_BETWEEN_COLUMNS);
    }
    for (int k=0; k<12; k++) digitalWrite(povPins[k], 1);
      delayMicroseconds(povIntervalLetters); //delayMicroseconds(POV_US_BETWEEN_LETTERS);
      
     
  }
}

void povUpdateInterval() {
  
  unsigned long interval = max((millis() - povTimeStamp),2)-1;
   povTimeStamp = millis() ;
   povIntervalColumns = interval  * 30 / 10 ; //povIntervalColumns = interval / 10 * 33 ;
   povIntervalLetters = interval  * 43 / 10; //povIntervalLetters = interval / 10 * 45;
   
   
   povIntervalColumns = min(povIntervalColumns,1650);
   povIntervalLetters = min(povIntervalLetters,2250);
  
}

void povWaitAndDisplay() {

 // Wait for hall then display
 while ( digitalRead(A3) == HIGH );
 
 
   povUpdateInterval();
   
   povDisplay();
  
}




